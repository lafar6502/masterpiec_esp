## main/Kconfig.projbuild
```kconfig
menu "Masterpiec Configuration"

    config BLINK_GPIO
        int "Blink GPIO number"
        range 0 34
        default 5
        help
            GPIO number (IOxx) to blink on and off.

    config ROT_ENC_A_GPIO
        int "Rotary Encoder A output GPIO number"
        range 0 39
        default 34
        help
            GPIO number (IOxx) from which to sample the Rotary Encoder 'A' output.
    
    config ROT_ENC_B_GPIO
        int "Rotary Encoder B output GPIO number"
        range 0 39
        default 35
        help
            GPIO number (IOxx) from which to sample the Rotary Encoder 'B' output.
    
    config ROT_ENC_BTN_GPIO
        int "Rotary Encoder button GPIO number"
        range 0 39
        default 33
        help
            GPIO number (IOxx) from which to sample the Rotary Encoder 'B' output.
            
    config DEBUG_OUT_GPIO
        int "Debug GPIO"
        range 0 39
        default 25
        help
            For output of debug signal.
            
    config ZERO_DETECT_GPIO
        int "Zero detector input GPIO"
        range 0 39
        default 32
        help
            AC zero detector input.
            
endmenu
```
